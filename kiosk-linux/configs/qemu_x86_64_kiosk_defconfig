## kiosk-linux/rmpg-shell/buildroot-package/Config.in
```kconfig
config BR2_PACKAGE_RMPG_SHELL
	bool "rmpg-shell"
	depends on BR2_PACKAGE_LIBGTK3
	depends on BR2_PACKAGE_LIBGTK3_X11
	depends on BR2_PACKAGE_XORG7
	select BR2_PACKAGE_WEBKITGTK
	help
	  RMPG Flex Desktop shell — two first-party components:

	  rmpg-shell, the taskbar (Start menu, live window list, clock,
	  battery/network/memory indicators, Wi-Fi picker, System
	  Information), and rmpg-browser, a tabbed WebKitGTK browser that
	  also provides the chromeless --app mode used to present RMPG
	  Flex as an application.

	  The Start menu serves a fixed, policy-controlled application
	  list from /etc/rmpg-desktop/apps.conf, which is what makes the
	  locked-down terminal requirement enforceable.

comment "rmpg-shell needs a GTK3 X11 build"
	depends on !BR2_PACKAGE_LIBGTK3 || !BR2_PACKAGE_LIBGTK3_X11
```
